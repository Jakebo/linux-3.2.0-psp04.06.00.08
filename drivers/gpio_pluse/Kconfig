## drivers/gpio_pluse/Kconfig
```kconfig
#
# Character device configuration
#

menu "gpio_pluse ir support"


config GPIO_PLUSE

tristate "gpio_pluse ir support"
default y
help
	gpio serial
endmenu
```
